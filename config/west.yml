## config/west.yml
```yaml
manifest:
  remotes:
    - name: zmkfirmware
      url-base: https://github.com/zmkfirmware
    - name: bogamie
      url-base: https://github.com/bogamie

  projects:
    - name: zmk
      remote: zmkfirmware
      revision: v0.2
      import: app/west.yml

    - name: zmk-split-battery-tray
      remote: bogamie
      revision: main

  self:
    path: config
```
